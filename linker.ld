OUTPUT_FORMAT(elf64-x86-64)
ENTRY(_start)

SECTIONS
{
    /* Kernel ładowany przez UEFI pod 0x00100000 */
    . = 0x00100000;

    /* ==============================================================
       TEXT
       ============================================================== */

    .text : ALIGN(16)
    {
        *(.text._start)
        *(.text)
        *(.text.*)
    }

    /* ==============================================================
       READ ONLY DATA
       ============================================================== */

    .rodata : ALIGN(16)
    {
        *(.rodata)
        *(.rodata.*)
    }

    /* ==============================================================
       DATA
       ============================================================== */

    .data : ALIGN(16)
    {
        *(.data)
        *(.data.*)
    }

    /* ==============================================================
       BSS
       ============================================================== */

    .bss : ALIGN(16)
    {
        /*
         * Kernel.asm używa tych symboli do wyzerowania BSS.
         */
        __bss_start = .;

        *(COMMON)
        *(.bss)
        *(.bss.*)

        __bss_end = .;
    }

    /* ==============================================================
       DISCARD
       ============================================================== */

    /DISCARD/ :
    {
        *(.comment)
        *(.note*)
        *(.eh_frame*)
    }
}